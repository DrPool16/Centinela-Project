## firmware/dts/bindings/nxp,kinetis-spi.yaml
```yaml
description: NXP Kinetis SPI controller (bare-metal driver)

compatible: "nxp,kinetis-spi"

include: [spi-controller.yaml, pinctrl-device.yaml]

properties:
  reg:
    required: true
  clocks:
    required: false
  clock-frequency:
    type: int
    default: 1000000
    description: SPI bus clock frequency in Hz
```
